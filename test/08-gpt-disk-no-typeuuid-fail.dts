/dts-v1/;

#include "barebox-state.dtsi"

/ {
	disk: loopfile {
		compatible = "barebox,hostfile";
		barebox,filename = __GPT_NO_TYPEUUID_LOOPDEV__;
		barebox,blockdev;
	};
};

&state {
	backend = <&disk>;
	backend-type = "raw";
	backend-stridesize = <0x40>;
	backend-storage-type = "direct";
};
